// SPDX-License-Identifier: (GPL-2.0+ OR MIT)
/dts-v1/;

#include "meson-g12b-a311d.dtsi"
#include "meson-libretech-cottonwood-cm.dtsi"
#include "meson-g12b-libretech-cottonwood-cm.dtsi"
#include "meson-libretech-cottonwood-cm-rpi-cm-io.dtsi"

/ {
	compatible = "libretech,aml-a311d-cm-v01", "amlogic,a311d", "amlogic,g12b";
	model = "Libre Computer AML-A311D-CM-V01 on RPi CM5-IO";
};
