// SPDX-License-Identifier: (GPL-2.0+ OR MIT)
/*
 * Libre Computer AML-A311D-CM on RPi CM4IO carrier board
 */

/dts-v1/;

#include "meson-g12b-a311d.dtsi"
#include "meson-libretech-cottonwood-cm.dtsi"
#include "meson-g12b-libretech-cottonwood-cm.dtsi"
#include "meson-libretech-cottonwood-cm-rpi-cm-io.dtsi"
#include "meson-libretech-cottonwood-cm-rpi-cm4-io.dtsi"

/ {
	compatible = "libretech,aml-a311d-cm", "amlogic,a311d", "amlogic,g12b";
	model = "Libre Computer AML-A311D-CM on RPi CM4-IO";
};
