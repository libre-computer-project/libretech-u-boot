// SPDX-License-Identifier: (GPL-2.0+ OR MIT)
/*
 * Copyright (c) 2024 Da Xue <da@libre.computer>
 * AML-S905D3-CC with ILI9486 SPI display
 */

/dts-v1/;

#include <dt-bindings/gpio/gpio.h>
#include <dt-bindings/gpio/meson-g12a-gpio.h>
#include "meson-sm1-s905d3-libretech-cc.dts"

/ {
	model = "Libre Computer AML-S905D3-CC Solitude with ILI9486";
};

&spicc1 {
	status = "okay";
	pinctrl-0 = <&spicc1_pins>, <&spicc1_ss0_pins>;
	pinctrl-names = "default";

	ili9486: display@0 {
		compatible = "ilitek,ili9486";
		reg = <0>;
		spi-max-frequency = <166666664>;
		dc-gpios = <&gpio GPIOA_5 GPIO_ACTIVE_HIGH>;
		reset-gpios = <&gpio GPIOA_6 GPIO_ACTIVE_HIGH>;
		buswidth = <8>;
	};
};
