// SPDX-License-Identifier: (GPL-2.0+ OR MIT)
/*
 * Libre Computer AML-A311D-CM (Alta Compute Module)
 *
 * Base module DTS without carrier board. Used by u-boot.
 * For carrier-specific DTS, see:
 *   meson-g12b-a311d-libretech-cm-rpi-cm4-io.dts
 *   meson-g12b-a311d-libretech-cm-rpi-cm5-io.dts
 */

/dts-v1/;

#include "meson-g12b-a311d.dtsi"
#include "meson-libretech-cottonwood-cm.dtsi"
#include "meson-g12b-libretech-cottonwood-cm.dtsi"

/ {
	compatible = "libretech,aml-a311d-cm", "amlogic,a311d", "amlogic,g12b";
	model = "Libre Computer AML-A311D-CM";
};
