// SPDX-License-Identifier: (GPL-2.0+ OR MIT)
/*
 * Libre Computer AML-A311D-CM on RPi CM5IO carrier board
 *
 * CM5IO differences from CM4IO:
 * - No CVBS (pin 111 repurposed for VBUS_EN)
 * - M.2 M-key PCIe slot (vs full-size on CM4IO)
 * - USB 3.0 ports available (but AML combo PHY shared with PCIe)
 */

/dts-v1/;

#include "meson-g12b-a311d.dtsi"
#include "meson-libretech-cottonwood-cm.dtsi"
#include "meson-g12b-libretech-cottonwood-cm.dtsi"
#include "meson-libretech-cottonwood-cm-io.dtsi"

/ {
	compatible = "libretech,aml-a311d-cm", "amlogic,a311d", "amlogic,g12b";
	model = "Libre Computer AML-A311D-CM on CM5IO";
};
