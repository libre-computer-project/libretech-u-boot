// SPDX-License-Identifier: (GPL-2.0+ OR MIT)
/*
 * Libre Computer AML-S905D3-CM (Solitude Compute Module)
 *
 * Base module DTS without carrier board. Used by u-boot.
 * For carrier-specific DTS, see:
 *   meson-sm1-s905d3-libretech-cm-rpi-cm4-io.dts
 *   meson-sm1-s905d3-libretech-cm-rpi-cm5-io.dts
 */

/dts-v1/;

#include "meson-sm1.dtsi"
#include "meson-libretech-cottonwood-cm.dtsi"
#include "meson-sm1-libretech-cottonwood-cm.dtsi"

/ {
	compatible = "libretech,aml-s905d3-cm", "amlogic,sm1";
	model = "Libre Computer AML-S905D3-CM";
};
