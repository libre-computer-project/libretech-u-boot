// SPDX-License-Identifier: (GPL-2.0+ OR MIT)
/*
 * Libre Computer AML-S905D3-CM on RPi CM5IO carrier board
 *
 * CM5IO differences from CM4IO:
 * - No CVBS (pin 111 repurposed for VBUS_EN)
 * - M.2 M-key PCIe slot (vs full-size on CM4IO)
 * - USB 3.0 ports available (but AML combo PHY shared with PCIe)
 */

/dts-v1/;

#include "meson-sm1.dtsi"
#include "meson-libretech-cottonwood-cm.dtsi"
#include "meson-sm1-libretech-cottonwood-cm.dtsi"
#include "meson-libretech-cottonwood-cm-io.dtsi"

/ {
	compatible = "libretech,aml-s905d3-cm", "amlogic,sm1";
	model = "Libre Computer AML-S905D3-CM on CM5IO";
};
